## config/west.yml
```yaml
manifest:
  remotes:
    - name: zmkfirmware
      url-base: https://github.com/zmkfirmware
    - name: YomenC
      url-base: https://github.com/YomenC
  projects:
    - name: zmk
      remote: zmkfirmware
      revision: main
      import: app/west.yml
    - name: tako-drivers-zmk-module
      remote: YomenC
      revision: main
  self:
    path: config
```
